// fock_right.overlay

#include "fock.dtsi" 

&default_transform {
    // each half has 7 columns
    col-offset = <7>;
};

&kscan0 {
    col-gpios =
        <&pro_micro 10 GPIO_ACTIVE_HIGH>, // thumb   7 
        <&pro_micro 4 GPIO_ACTIVE_HIGH>,  // inner   8 
        <&pro_micro 5 GPIO_ACTIVE_HIGH>,  // index   9 
        <&pro_micro 6 GPIO_ACTIVE_HIGH>,  // middle 10
        <&pro_micro 7 GPIO_ACTIVE_HIGH>,  // ring   11 
        <&pro_micro 8 GPIO_ACTIVE_HIGH>,  // pinky  12 
        <&pro_micro 9 GPIO_ACTIVE_HIGH>   // outer  13 
        ;
};
